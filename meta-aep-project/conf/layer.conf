## meta-aep-project/conf/layer.conf
```bitbake
# We have a conf and classes directory, add to BBPATH
BBPATH .= ":${LAYERDIR}"

# We have recipes-* directories, add to BBFILES
BBFILES += "${LAYERDIR}/recipes-*/*/*.bb \
            ${LAYERDIR}/recipes-*/*/*.bbappend"

BBFILE_COLLECTIONS += "meta-aep-project"
BBFILE_PATTERN_meta-aep-project = "^${LAYERDIR}/"
BBFILE_PRIORITY_meta-aep-project = "6"

LAYERDEPENDS_meta-aep-project = "core"
LAYERSERIES_COMPAT_meta-aep-project = "kirkstone"
```
